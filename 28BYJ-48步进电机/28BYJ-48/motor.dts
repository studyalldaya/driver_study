/{
	motor_dev {
		compatible = "100ask,motor";
		pinctrl-names = "default";
    	pinctrl-0 = <&pinctrl_motor>;
		motor-gpios = <&gpio4 19 GPIO_ACTIVE_HIGH>,
					<&gpio4 20 GPIO_ACTIVE_HIGH>,
					<&gpio4 21 GPIO_ACTIVE_HIGH>,
					<&gpio4 22 GPIO_ACTIVE_HIGH>;
		
	};
};

&iomuxc {
       pinctrl_motor: motorgrp {
            fsl,pins = <
                MX6UL_PAD_CSI_VSYNC__GPIO4_IO19            0x90B0
                MX6UL_PAD_CSI_HSYNC__GPIO4_IO20            0x90B0
                MX6UL_PAD_CSI_DATA00__GPIO4_IO21           0x90B0
                MX6UL_PAD_CSI_DATA01__GPIO4_IO22           0x90B0
            >;
        };
};